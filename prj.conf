## CMakeLists.txt
```
cmake_minimum_required(VERSION 3.20.0)

find_package(Zephyr REQUIRED HINTS $ENV{ZEPHYR_BASE})
project(esp32s3_ble_macro_knob)

target_sources(app PRIVATE 
    src/main.c
    src/ble_hid.c
    src/adc_knob.c
    src/button_mode.c
    src/status_led.c
)
```

## prj.conf
```kconfig
CONFIG_PRINTK=y
CONFIG_LOG=y

# Bluetooth Core
CONFIG_BT=y
CONFIG_BT_PERIPHERAL=y
CONFIG_BT_DEVICE_NAME="ESP32-DeskKnob"
CONFIG_BT_DEVICE_APPEARANCE=961

# Security & Bonding
CONFIG_BT_SMP=y
CONFIG_BT_BONDABLE=y
CONFIG_BT_SETTINGS=y
CONFIG_SETTINGS=y
CONFIG_FLASH=y
CONFIG_NVS=y

# Drivers
CONFIG_GPIO=y
CONFIG_ADC=y
CONFIG_ADC_ESP32=y
```

## app.overlay
```dts
&adc0 {
    status = "okay";
    #address-cells = <1>;
    #size-cells = <0>;

    channel@6 {
        reg = <6>;
        zephyr,gain = "ADC_GAIN_1_4";
        zephyr,reference = "ADC_REF_INTERNAL";
        zephyr,acquisition-time = <ADC_ACQ_TIME_DEFAULT>;
        zephyr,resolution = <12>;
    };
};
```

## src/main.c
```c
#include <zephyr/kernel.h>
#include <zephyr/sys/printk.h>
#include "ble_hid.h"
#include "adc_knob.h"
#include "button_mode.h"
#include "status_led.h"

int main(void)
{
    k_msleep(500);
    printk("\n=== 3-Mode BLE Controller (With RGB Status LED) ===\n");

    status_led_init();

    if (button_mode_init() < 0) {
        printk("Button driver init failed\n");
    }

    if (adc_knob_init() < 0) {
        printk("ADC knob driver init failed\n");
    }

    if (ble_hid_init() < 0) {
        printk("BLE HID init failed\n");
    }

    printk("Ready. Initial State: [MODE 1: MEDIA (LED: BLUE)]\n");

    while (1) {
        k_msleep(20);

        button_mode_process();

        if (ble_hid_is_connected()) {
            int knob_event = adc_knob_process();
            controller_mode_t mode = button_mode_get_current();

            if (knob_event == KNOB_EVENT_CW) {
                if (mode == MODE_MEDIA) {
                    printk("[KNOB][MEDIA] VOL UP\n");
                    ble_hid_send_consumer_key(HID_KEY_VOL_UP);
                } else if (mode == MODE_NAVIGATION) {
                    printk("[KNOB][NAV] SCROLL DOWN\n");
                    ble_hid_send_mouse_scroll(-1);
                } else if (mode == MODE_SYSTEM) {
                    printk("[KNOB][SYSTEM] BRIGHTNESS UP\n");
                    ble_hid_send_consumer_key(HID_KEY_BRIGHTNESS_UP);
                }
            } else if (knob_event == KNOB_EVENT_CCW) {
                if (mode == MODE_MEDIA) {
                    printk("[KNOB][MEDIA] VOL DOWN\n");
                    ble_hid_send_consumer_key(HID_KEY_VOL_DOWN);
                } else if (mode == MODE_NAVIGATION) {
                    printk("[KNOB][NAV] SCROLL UP\n");
                    ble_hid_send_mouse_scroll(1);
                } else if (mode == MODE_SYSTEM) {
                    printk("[KNOB][SYSTEM] BRIGHTNESS DOWN\n");
                    ble_hid_send_consumer_key(HID_KEY_BRIGHTNESS_DOWN);
                }
            }
        }
    }

    return 0;
}
```

## src/adc_knob.c
```c
#include "adc_knob.h"
#include <zephyr/kernel.h>
#include <zephyr/sys/printk.h>
#include <zephyr/drivers/adc.h>

#define ADC_POT_CHANNEL     6       /* GPIO 7 is ADC1_CH6 on ESP32-S3 */
#define ADC_STEP_THRESHOLD  50      /* Step sensitivity */

static const struct device *adc_dev;
static int16_t adc_raw_buf;
static int32_t ema_pot_val = 2048;
static int32_t last_sent_val = 2048;

static struct adc_channel_cfg channel_cfg = {
    .gain = ADC_GAIN_1_4,           /* Full 3.3V range attenuation */
    .reference = ADC_REF_INTERNAL,
    .acquisition_time = ADC_ACQ_TIME_DEFAULT,
    .channel_id = ADC_POT_CHANNEL,
};

static struct adc_sequence sequence = {
    .channels = BIT(ADC_POT_CHANNEL),
    .buffer = &adc_raw_buf,
    .buffer_size = sizeof(adc_raw_buf),
    .resolution = 12,
};

int adc_knob_init(void)
{
    adc_dev = DEVICE_DT_GET(DT_NODELABEL(adc0));
    if (!device_is_ready(adc_dev)) {
        printk("ADC device not ready\n");
        return -ENODEV;
    }

    int err = adc_channel_setup(adc_dev, &channel_cfg);
    if (err) {
        printk("ADC setup failed: %d\n", err);
        return err;
    }

    if (adc_read(adc_dev, &sequence) == 0) {
        ema_pot_val = adc_raw_buf;
        last_sent_val = adc_raw_buf;
    }

    printk("ADC initialized on GPIO 7 with 12dB full 3.3V attenuation\n");
    return 0;
}

int adc_knob_process(void)
{
    if (!device_is_ready(adc_dev)) {
        return KNOB_EVENT_NONE;
    }

    if (adc_read(adc_dev, &sequence) == 0) {
        /* EMA Smoothing */
        ema_pot_val = (adc_raw_buf + (3 * ema_pot_val)) / 4;
        int delta = ema_pot_val - last_sent_val;

        if (delta >= ADC_STEP_THRESHOLD) {
            last_sent_val = ema_pot_val;
            return KNOB_EVENT_CW;
        } else if (delta <= -ADC_STEP_THRESHOLD) {
            last_sent_val = ema_pot_val;
            return KNOB_EVENT_CCW;
        }
    }

    return KNOB_EVENT_NONE;
}
```

## src/adc_knob.h
```c
#ifndef ADC_KNOB_H_
#define ADC_KNOB_H_

#include <stdint.h>

#define KNOB_EVENT_NONE     0
#define KNOB_EVENT_CW       1   /* Clockwise / Step Up */
#define KNOB_EVENT_CCW      2   /* Counter-Clockwise / Step Down */

int adc_knob_init(void);
int adc_knob_process(void);

#endif /* ADC_KNOB_H_ */
```

## src/ble_hid.c
```c
#include "ble_hid.h"
#include <zephyr/kernel.h>
#include <zephyr/sys/printk.h>
#include <zephyr/bluetooth/bluetooth.h>
#include <zephyr/bluetooth/conn.h>
#include <zephyr/bluetooth/gatt.h>
#include <zephyr/bluetooth/uuid.h>
#include <zephyr/settings/settings.h>

static struct bt_conn *current_conn = NULL;

/* Composite HID Report Map: Consumer Control (ID 1) + Mouse Wheel (ID 2) */
static const uint8_t hid_report_map[] = {
    /* --- REPORT ID 1: Consumer Control (Media & Brightness) --- */
    0x05, 0x0C,       /* Usage Page (Consumer Devices) */
    0x09, 0x01,       /* Usage (Consumer Control) */
    0xA1, 0x01,       /* Collection (Application) */
    0x85, 0x01,       /*   Report ID (1) */
    0x15, 0x00,       /*   Logical Minimum (0) */
    0x25, 0x01,       /*   Logical Maximum (1) */
    0x75, 0x01,       /*   Report Size (1 bit) */
    0x95, 0x08,       /*   Report Count (8 functional bits) */
    0x09, 0xE9,       /*   Bit 0: Volume Increment */
    0x09, 0xEA,       /*   Bit 1: Volume Decrement */
    0x09, 0xE2,       /*   Bit 2: Mute */
    0x09, 0xCD,       /*   Bit 3: Play/Pause */
    0x09, 0xB5,       /*   Bit 4: Scan Next Track */
    0x09, 0xB6,       /*   Bit 5: Scan Prev Track */
    0x09, 0x6F,       /*   Bit 6: Brightness Increment */
    0x09, 0x70,       /*   Bit 7: Brightness Decrement */
    0x81, 0x02,       /*   Input (Data, Variable, Absolute) */
    0xC0,             /* End Collection */

    /* --- REPORT ID 2: Mouse (Wheel Scroll) --- */
    0x05, 0x01,       /* Usage Page (Generic Desktop) */
    0x09, 0x02,       /* Usage (Mouse) */
    0xA1, 0x01,       /* Collection (Application) */
    0x85, 0x02,       /*   Report ID (2) */
    0x09, 0x01,       /*   Usage (Pointer) */
    0xA1, 0x00,       /*   Collection (Physical) */
    0x05, 0x09,       /*     Usage Page (Buttons) */
    0x19, 0x01,       /*     Usage Minimum (1) */
    0x29, 0x03,       /*     Usage Maximum (3) */
    0x15, 0x00,       /*     Logical Minimum (0) */
    0x25, 0x01,       /*     Logical Maximum (1) */
    0x95, 0x03,       /*     Report Count (3 buttons) */
    0x75, 0x01,       /*     Report Size (1 bit) */
    0x81, 0x02,       /*     Input (Data, Variable, Absolute) */
    0x95, 0x01,       /*     Report Count (1) */
    0x75, 0x05,       /*     Report Size (5 bits padding) */
    0x81, 0x01,       /*     Input (Constant) */
    0x05, 0x01,       /*     Usage Page (Generic Desktop) */
    0x09, 0x30,       /*     Usage (X) */
    0x09, 0x31,       /*     Usage (Y) */
    0x09, 0x38,       /*     Usage (Wheel) */
    0x15, 0x81,       /*     Logical Minimum (-127) */
    0x25, 0x7F,       /*     Logical Maximum (127) */
    0x75, 0x08,       /*     Report Size (8 bits) */
    0x95, 0x03,       /*     Report Count (3 axes: X, Y, Wheel) */
    0x81, 0x06,       /*     Input (Data, Variable, Relative) */
    0xC0,             /*   End Collection */
    0xC0              /* End Collection */
};

static const uint8_t hid_info[] = { 0x01, 0x01, 0x00, 0x02 };
static uint8_t hid_protocol_mode = 0x01;
static uint8_t hid_ctrl_point;
static uint8_t hid_consumer_input;
static uint8_t hid_mouse_input[4];

static const uint8_t report_ref_consumer[] = { REPORT_ID_CONSUMER, 0x01 };
static const uint8_t report_ref_mouse[]    = { REPORT_ID_MOUSE, 0x01 };

static ssize_t read_report_map(struct bt_conn *conn, const struct bt_gatt_attr *attr,
                               void *buf, uint16_t len, uint16_t offset)
{
    return bt_gatt_attr_read(conn, attr, buf, len, offset, hid_report_map, sizeof(hid_report_map));
}

static ssize_t read_hid_info(struct bt_conn *conn, const struct bt_gatt_attr *attr,
                             void *buf, uint16_t len, uint16_t offset)
{
    return bt_gatt_attr_read(conn, attr, buf, len, offset, hid_info, sizeof(hid_info));
}

static ssize_t read_report_ref_consumer(struct bt_conn *conn, const struct bt_gatt_attr *attr,
                                        void *buf, uint16_t len, uint16_t offset)
{
    return bt_gatt_attr_read(conn, attr, buf, len, offset, report_ref_consumer, sizeof(report_ref_consumer));
}

static ssize_t read_report_ref_mouse(struct bt_conn *conn, const struct bt_gatt_attr *attr,
                                     void *buf, uint16_t len, uint16_t offset)
{
    return bt_gatt_attr_read(conn, attr, buf, len, offset, report_ref_mouse, sizeof(report_ref_mouse));
}

static ssize_t read_protocol_mode(struct bt_conn *conn, const struct bt_gatt_attr *attr,
                                  void *buf, uint16_t len, uint16_t offset)
{
    return bt_gatt_attr_read(conn, attr, buf, len, offset, &hid_protocol_mode, sizeof(hid_protocol_mode));
}

static ssize_t write_ctrl_point(struct bt_conn *conn, const struct bt_gatt_attr *attr,
                                const void *buf, uint16_t len, uint16_t offset, uint8_t flags)
{
    ARG_UNUSED(conn);
    ARG_UNUSED(attr);
    ARG_UNUSED(buf);
    ARG_UNUSED(offset);
    ARG_UNUSED(flags);
    return len;
}

static const struct bt_data ad[] = {
    BT_DATA_BYTES(BT_DATA_FLAGS, (BT_LE_AD_GENERAL | BT_LE_AD_NO_BREDR)),
    BT_DATA_BYTES(BT_DATA_UUID16_ALL, BT_UUID_16_ENCODE(BT_UUID_HIDS_VAL)),
};

static const struct bt_data sd[] = {
    BT_DATA(BT_DATA_NAME_COMPLETE, CONFIG_BT_DEVICE_NAME, sizeof(CONFIG_BT_DEVICE_NAME) - 1),
};

static void adv_restart_handler(struct k_work *work);
K_WORK_DELAYABLE_DEFINE(adv_restart_work, adv_restart_handler);

static void adv_restart_handler(struct k_work *work)
{
    ARG_UNUSED(work);
    bt_le_adv_start(BT_LE_ADV_CONN_FAST_1, ad, ARRAY_SIZE(ad), sd, ARRAY_SIZE(sd));
}

static void connected(struct bt_conn *conn, uint8_t err)
{
    if (err) {
        printk("Connection failed: 0x%02x\n", err);
        return;
    }
    current_conn = bt_conn_ref(conn);
    printk(">>> CONNECTED TO PC <<<\n");
    bt_conn_set_security(conn, BT_SECURITY_L2);
}

static void disconnected(struct bt_conn *conn, uint8_t reason)
{
    printk("Disconnected: 0x%02x\n", reason);
    if (current_conn) {
        bt_conn_unref(current_conn);
        current_conn = NULL;
    }
    k_work_reschedule(&adv_restart_work, K_MSEC(200));
}

static void security_changed(struct bt_conn *conn, bt_security_t level, enum bt_security_err err)
{
    ARG_UNUSED(conn);
    if (!err && level >= BT_SECURITY_L2) {
        printk("Security established (Level %d)\n", level);
    }
}

BT_CONN_CB_DEFINE(conn_callbacks) = {
    .connected = connected,
    .disconnected = disconnected,
    .security_changed = security_changed,
};

BT_GATT_SERVICE_DEFINE(hids_svc,
    BT_GATT_PRIMARY_SERVICE(BT_UUID_HIDS),

    BT_GATT_CHARACTERISTIC(BT_UUID_HIDS_PROTOCOL_MODE,
                           BT_GATT_CHRC_READ | BT_GATT_CHRC_WRITE_WITHOUT_RESP,
                           BT_GATT_PERM_READ | BT_GATT_PERM_WRITE,
                           read_protocol_mode, NULL, &hid_protocol_mode),

    BT_GATT_CHARACTERISTIC(BT_UUID_HIDS_INFO,
                           BT_GATT_CHRC_READ,
                           BT_GATT_PERM_READ,
                           read_hid_info, NULL, NULL),

    BT_GATT_CHARACTERISTIC(BT_UUID_HIDS_CTRL_POINT,
                           BT_GATT_CHRC_WRITE_WITHOUT_RESP,
                           BT_GATT_PERM_WRITE,
                           NULL, write_ctrl_point, &hid_ctrl_point),

    BT_GATT_CHARACTERISTIC(BT_UUID_HIDS_REPORT_MAP,
                           BT_GATT_CHRC_READ,
                           BT_GATT_PERM_READ,
                           read_report_map, NULL, NULL),

    /* Characteristic Index 9: Consumer Report (ID 1) */
    BT_GATT_CHARACTERISTIC(BT_UUID_HIDS_REPORT,
                           BT_GATT_CHRC_READ | BT_GATT_CHRC_NOTIFY,
                           BT_GATT_PERM_READ,
                           NULL, NULL, &hid_consumer_input),
    BT_GATT_CCC(NULL, BT_GATT_PERM_READ | BT_GATT_PERM_WRITE),
    BT_GATT_DESCRIPTOR(BT_UUID_HIDS_REPORT_REF,
                       BT_GATT_PERM_READ,
                       read_report_ref_consumer, NULL, NULL),

    /* Characteristic Index 13: Mouse Report (ID 2) */
    BT_GATT_CHARACTERISTIC(BT_UUID_HIDS_REPORT,
                           BT_GATT_CHRC_READ | BT_GATT_CHRC_NOTIFY,
                           BT_GATT_PERM_READ,
                           NULL, NULL, hid_mouse_input),
    BT_GATT_CCC(NULL, BT_GATT_PERM_READ | BT_GATT_PERM_WRITE),
    BT_GATT_DESCRIPTOR(BT_UUID_HIDS_REPORT_REF,
                       BT_GATT_PERM_READ,
                       read_report_ref_mouse, NULL, NULL),
);

static void pairing_confirm(struct bt_conn *conn)
{
    bt_conn_auth_pairing_confirm(conn);
}

static void auth_cancel(struct bt_conn *conn)
{
    ARG_UNUSED(conn);
}

static struct bt_conn_auth_cb auth_cb_display = {
    .pairing_confirm = pairing_confirm,
    .cancel = auth_cancel,
};

static void pairing_complete(struct bt_conn *conn, bool bonded)
{
    ARG_UNUSED(conn);
    printk("Pairing bonded: %s\n", bonded ? "true" : "false");
}

static struct bt_conn_auth_info_cb auth_info_cb = {
    .pairing_complete = pairing_complete,
};

bool ble_hid_is_connected(void)
{
    return current_conn != NULL;
}

int ble_hid_send_consumer_key(uint8_t key_mask)
{
    if (!current_conn) {
        return -ENOTCONN;
    }

    const struct bt_gatt_attr *report_attr = &hids_svc.attrs[9];
    uint8_t report = key_mask;
    int err;

    /* Press */
    err = bt_gatt_notify(current_conn, report_attr, &report, sizeof(report));
    if (err) {
        return err;
    }

    k_msleep(20);

    /* Release */
    report = HID_KEY_NONE;
    err = bt_gatt_notify(current_conn, report_attr, &report, sizeof(report));
    return err;
}

int ble_hid_send_mouse_scroll(int8_t scroll_steps)
{
    if (!current_conn) {
        return -ENOTCONN;
    }

    const struct bt_gatt_attr *report_attr = &hids_svc.attrs[13];
    /* Mouse Report Format: [Buttons, delta_X, delta_Y, delta_Wheel] */
    uint8_t mouse_report[4] = { 0x00, 0x00, 0x00, (uint8_t)scroll_steps };

    return bt_gatt_notify(current_conn, report_attr, mouse_report, sizeof(mouse_report));
}

int ble_hid_init(void)
{
    bt_conn_auth_cb_register(&auth_cb_display);
    bt_conn_auth_info_cb_register(&auth_info_cb);

    int err = bt_enable(NULL);
    if (err) {
        printk("BT init fail: %d\n", err);
        return err;
    }

    if (IS_ENABLED(CONFIG_SETTINGS)) {
        settings_subsys_init();
        settings_load();
    }

    size_t id_count = 0;
    bt_id_get(NULL, &id_count);
    if (id_count == 0) {
        bt_id_create(NULL, NULL);
    }

    return bt_le_adv_start(BT_LE_ADV_CONN_FAST_1, ad, ARRAY_SIZE(ad), sd, ARRAY_SIZE(sd));
}
```

## src/ble_hid.h
```c
#ifndef BLE_HID_H_
#define BLE_HID_H_

#include <stdint.h>
#include <stdbool.h>

#define REPORT_ID_CONSUMER      1
#define REPORT_ID_MOUSE         2

/* Consumer Control Keys */
#define HID_KEY_NONE            0x00
#define HID_KEY_VOL_UP          (1 << 0) /* Bit 0: Vol Up */
#define HID_KEY_VOL_DOWN        (1 << 1) /* Bit 1: Vol Down */
#define HID_KEY_MUTE            (1 << 2) /* Bit 2: Mute */
#define HID_KEY_PLAY_PAUSE      (1 << 3) /* Bit 3: Play/Pause */
#define HID_KEY_NEXT_TRACK      (1 << 4) /* Bit 4: Next Track */
#define HID_KEY_PREV_TRACK      (1 << 5) /* Bit 5: Previous Track */
#define HID_KEY_BRIGHTNESS_UP   (1 << 6) /* Bit 6: Brightness Up */
#define HID_KEY_BRIGHTNESS_DOWN (1 << 7) /* Bit 7: Brightness Down */

int ble_hid_init(void);
bool ble_hid_is_connected(void);
int ble_hid_send_consumer_key(uint8_t key_mask);
int ble_hid_send_mouse_scroll(int8_t scroll_steps);

#endif /* BLE_HID_H_ */
```

## src/button_mode.c
```c
#include "button_mode.h"
#include "ble_hid.h"
#include "status_led.h"
#include <zephyr/kernel.h>
#include <zephyr/sys/printk.h>
#include <zephyr/drivers/gpio.h>

#define BTN_MODE_PIN        6       /* GPIO 6: Mode Cycle */
#define BTN_PLAY_PIN        5       /* GPIO 5: Play/Pause */
#define BTN_TRACK_PIN       4       /* GPIO 4: Secondary Action */
#define HOLD_THRESHOLD_MS   800

static const struct device *gpio_dev;
static controller_mode_t current_mode = MODE_MEDIA;

static int btn_mode_last = 1;
static int btn_play_last = 1;
static int btn_track_last = 1;
static int64_t track_press_time = 0;
static bool track_long_handled = false;

int button_mode_init(void)
{
    gpio_dev = DEVICE_DT_GET(DT_NODELABEL(gpio0));
    if (!device_is_ready(gpio_dev)) {
        printk("GPIO0 device not ready\n");
        return -ENODEV;
    }

    gpio_pin_configure(gpio_dev, BTN_MODE_PIN, GPIO_INPUT | GPIO_PULL_UP);
    gpio_pin_configure(gpio_dev, BTN_PLAY_PIN, GPIO_INPUT | GPIO_PULL_UP);
    gpio_pin_configure(gpio_dev, BTN_TRACK_PIN, GPIO_INPUT | GPIO_PULL_UP);

    return 0;
}

controller_mode_t button_mode_get_current(void)
{
    return current_mode;
}

void button_mode_process(void)
{
    int64_t now = k_uptime_get();

    int mode_val = gpio_pin_get(gpio_dev, BTN_MODE_PIN);
    int play_val = gpio_pin_get(gpio_dev, BTN_PLAY_PIN);
    int track_val = gpio_pin_get(gpio_dev, BTN_TRACK_PIN);

    /* Button 1 (GPIO 6): Cycle Modes & Update LED */
    if (mode_val == 0 && btn_mode_last == 1) {
        current_mode = (current_mode + 1) % MODE_COUNT;
        status_led_set_mode(current_mode);

        switch (current_mode) {
        case MODE_MEDIA:
            printk("\n>>> [MODE 1: MEDIA (LED: BLUE)] <<<\n");
            break;
        case MODE_NAVIGATION:
            printk("\n>>> [MODE 2: NAVIGATION (LED: GREEN)] <<<\n");
            break;
        case MODE_SYSTEM:
            printk("\n>>> [MODE 3: SYSTEM (LED: MAGENTA)] <<<\n");
            break;
        default:
            break;
        }
        k_msleep(150);
    }

    /* Button 2 (GPIO 5): Play / Pause */
    if (play_val == 0 && btn_play_last == 1) {
        printk("[BUTTON 2] PLAY / PAUSE\n");
        ble_hid_send_consumer_key(HID_KEY_PLAY_PAUSE);
        k_msleep(100);
    }

    /* Button 3 (GPIO 4): Mode-dependent action */
    if (current_mode == MODE_MEDIA) {
        if (track_val == 0 && btn_track_last == 1) {
            track_press_time = now;
            track_long_handled = false;
        } else if (track_val == 0 && btn_track_last == 0) {
            if (!track_long_handled && (now - track_press_time) >= HOLD_THRESHOLD_MS) {
                printk("[BUTTON 3] PREVIOUS TRACK\n");
                ble_hid_send_consumer_key(HID_KEY_PREV_TRACK);
                track_long_handled = true;
            }
        } else if (track_val == 1 && btn_track_last == 0) {
            if (!track_long_handled) {
                printk("[BUTTON 3] NEXT TRACK\n");
                ble_hid_send_consumer_key(HID_KEY_NEXT_TRACK);
            }
        }
    } else {
        if (track_val == 0 && btn_track_last == 1) {
            printk("[BUTTON 3] MUTE\n");
            ble_hid_send_consumer_key(HID_KEY_MUTE);
            k_msleep(100);
        }
    }

    btn_mode_last = mode_val;
    btn_play_last = play_val;
    btn_track_last = track_val;
}
```

## src/button_mode.h
```c
#ifndef BUTTON_MODE_H_
#define BUTTON_MODE_H_

typedef enum {
    MODE_MEDIA = 0,      /* Mode 1: Volume & Media Playback */
    MODE_NAVIGATION = 1, /* Mode 2: Track Scrubbing */
    MODE_SYSTEM = 2,     /* Mode 3: Display Brightness Control */
    MODE_COUNT
} controller_mode_t;

int button_mode_init(void);
void button_mode_process(void);
controller_mode_t button_mode_get_current(void);

#endif /* BUTTON_MODE_H_ */
```

## src/status_led.c
```c
#include "status_led.h"
#include <zephyr/kernel.h>
#include <zephyr/drivers/gpio.h>
#include <zephyr/sys/printk.h>

#define STATUS_LED_PIN      10       /* GPIO 10: Standard Breadboard LED */

static const struct device *gpio0_dev;
static controller_mode_t active_mode = MODE_MEDIA;
static int blink_step = 0;

static void led_worker_handler(struct k_work *work);
static K_WORK_DELAYABLE_DEFINE(led_work, led_worker_handler);

static void led_set_state(int state)
{
    if (device_is_ready(gpio0_dev)) {
        gpio_pin_set(gpio0_dev, STATUS_LED_PIN, state);
    }
}

static void led_worker_handler(struct k_work *work)
{
    int next_delay_ms = 100;

    switch (active_mode) {
    case MODE_MEDIA:
        /* Mode 1: Solid ON */
        led_set_state(1);
        next_delay_ms = 500;
        break;

    case MODE_NAVIGATION:
        /* Mode 2: Blink twice (Flash -> Flash -> Pause) */
        if (blink_step == 0) {
            led_set_state(1);
            next_delay_ms = 120;
            blink_step++;
        } else if (blink_step == 1) {
            led_set_state(0);
            next_delay_ms = 120;
            blink_step++;
        } else if (blink_step == 2) {
            led_set_state(1);
            next_delay_ms = 120;
            blink_step++;
        } else {
            led_set_state(0);
            next_delay_ms = 1000;
            blink_step = 0;
        }
        break;

    case MODE_SYSTEM:
        /* Mode 3: Blink three times (Flash -> Flash -> Flash -> Pause) */
        if (blink_step == 0 || blink_step == 2 || blink_step == 4) {
            led_set_state(1);
            next_delay_ms = 120;
            blink_step++;
        } else if (blink_step == 1 || blink_step == 3) {
            led_set_state(0);
            next_delay_ms = 120;
            blink_step++;
        } else {
            led_set_state(0);
            next_delay_ms = 1000;
            blink_step = 0;
        }
        break;

    default:
        led_set_state(0);
        next_delay_ms = 1000;
        break;
    }

    k_work_reschedule(&led_work, K_MSEC(next_delay_ms));
}

int status_led_init(void)
{
    gpio0_dev = DEVICE_DT_GET(DT_NODELABEL(gpio0));
    if (!device_is_ready(gpio0_dev)) {
        printk("GPIO0 device not ready\n");
        return -ENODEV;
    }

    gpio_pin_configure(gpio0_dev, STATUS_LED_PIN, GPIO_OUTPUT_INACTIVE);

    printk("Discrete Status LED Initialized on GPIO 10\n");
    status_led_set_mode(MODE_MEDIA);
    return 0;
}

void status_led_set_mode(controller_mode_t mode)
{
    active_mode = mode;
    blink_step = 0;

    k_work_reschedule(&led_work, K_NO_WAIT);
}
```

## src/status_led.h
```c
#ifndef STATUS_LED_H_
#define STATUS_LED_H_

#include "button_mode.h"

int status_led_init(void);
void status_led_set_mode(controller_mode_t mode);

#endif /* STATUS_LED_H_ */
```
